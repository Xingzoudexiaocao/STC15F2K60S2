#include"stc15fxxxx.h"
#include<stdlib.h>
/*************************端口定义***************************/
#define LCD_data P0    //数据端口
sbit LCD_RS=P2^0; //液晶寄存器选择输入
sbit LCD_RW=P2^1; //液晶读写控制
sbit LCD_EN=P2^2; //液晶使能控制端
/************************************************************
功能描述：1ms延时函数
入口参数：uint x
出口参数：无
************************************************************/
void delay_1ms(u16 x)
{
	u16 i,j;
	for(j=0;j<x;j++)
	for(i=0;i<110;i++);
}


/************************************************************
功能描述:判断12864是否忙
入口参数：无
出口参数：无
************************************************************/
void lcd_busy(void)
{
  LCD_data=0xff;
  LCD_RW=1;
  LCD_RS=0;
  LCD_EN=1;
  while(LCD_data&0x80);
  LCD_EN=0;
}

/************************************************************
功能描述：根据12864的操作时序写指令数据到LCD12864
入口参数：cmd 写入的指令数据
出口参数：无
************************************************************/
void write_cmd(u8 cmd)  //cmd为指令
{
	lcd_busy();
	LCD_data=cmd;	//cmd就是指令数据，如cmd=0x0c，那么就是显示开，关光标
	LCD_RW=0;		   
	LCD_RS=0;
	LCD_EN=1;
	_nop_();
	LCD_EN=0;
}

/************************************************************
功能描述：根据12864的操作时序得，写显示数据到12864
入口参数：dat 写入的数据
出口参数：无
************************************************************/
void write_dat(u8 dat)      //dat为数据
{
	lcd_busy();
	LCD_data=dat;  //根据时序得，使能信号相对于RS，RW要稍微延时5ms，这是准备数据
	LCD_RW=0;
	LCD_RS=1;
	LCD_EN=1;
	_nop_();
	LCD_EN=0;
}

/************************************************************
功能描述：设定显示位置
入口参数：X,Y这里的X将要是第一个汉字的坐标，Y值是向右移动的汉字个数
出口参数：无
*************************************************************/
void lcd_pos(u8 X,u8 Y)
{	u8 pos;
	if(X==0)
		{X=0x80;} 	//根据汉字显示坐标而得，0x80为第一行第一个汉字的位置
	else if(X==1)
		{X=0x90;} 	//根据汉字显示坐标而得，0x90为第二行第一个汉字的位置
	else if(X==2)
		{X=0x88;} 	//根据汉字显示坐标而得，0x88为第三行第一个汉字的位置
	else if(X==3)
		{X=0x98;} 	//根据汉字显示坐标而得，0x98为第四行第一个汉字的位置
	pos=X+Y;	 	//pos为写入LCD指令数据，
				    //如X=0x80（第一行第一个汉字的位置），Y=2（右移个数），
                    // pos=X+Y=0x80+2=0x82（即第一行第三个汉字的位置）//
	write_cmd(pos);	//写入指令到LCD函数
} 

/************************************************************
功能描述：写字符串到LCD12864
入口参数：c 待写入字符串的首地址
出口参数：无
************************************************************/
void write_str(u8 *c)
{
	while(*c!=0)
  	{
  	 write_dat(*c);
   	c++;
  	}
}

/************************************************************
功能描述：LCD初始化的设定
入口参数：无
出口参数：无
************************************************************/
void lcd_init()
{
	write_cmd(0x30);        //基本指令操作
	delay_1ms(5);
	write_cmd(0x0c);        //显示开，关光标
	delay_1ms(5);
	write_cmd(0x01);        //清除LCD的显示内容
	delay_1ms(5);
}
